/*
 * Copyright (c) 2025 Noir Guo
 *
 * SPDX-License-Identifier: MIT
 */

#include "cygnus.dtsi"

&kscan0 {
    col-gpios
        = <&gpio0 31 GPIO_ACTIVE_HIGH>
        , <&gpio0 29 GPIO_ACTIVE_HIGH>
        , <&gpio0 2 GPIO_ACTIVE_HIGH>
        , <&gpio1 15 GPIO_ACTIVE_HIGH>
        , <&gpio1 13 GPIO_ACTIVE_HIGH>
        , <&gpio1 11 GPIO_ACTIVE_HIGH>
        ;

    left_encoder: encoder_left {
        compatible = "alps,ec11";
        steps = <80>;
        a-gpios = <&gpio0 10 (GPIO_ACTIVE_HIGH | GPIO_PULL_UP)>;
        b-gpios = <&gpio0 9 (GPIO_ACTIVE_HIGH | GPIO_PULL_UP)>;
        
        //a-gpios = <&gpio0 10 (GPIO_ACTIVE_HIGH | GPIO_PULL_DOWN)>;
        //b-gpios = <&gpio0 9 (GPIO_ACTIVE_HIGH | GPIO_PULL_DOWN)>;

        //a-gpios = <&gpio0 10 (GPIO_ACTIVE_LOW | GPIO_PULL_UP)>;
        //b-gpios = <&gpio0 9 (GPIO_ACTIVE_LOW | GPIO_PULL_UP)>;

        //a-gpios = <&gpio0 10 (GPIO_ACTIVE_LOW | GPIO_PULL_DOWN)>;
        //b-gpios = <&gpio0 9 (GPIO_ACTIVE_LOW | GPIO_PULL_DOWN)>;
        //status = "disabled";
        status = "okay";
    };

    sensors: sensors {
        compatible = "zmk,keymap-sensors";
        sensors = <&left_encoder>;
        //sensors = <&left_encoder &right_encoder>;
        triggers-per-rotation = <20>;
    };

};
